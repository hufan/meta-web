## sources/meta-myir-imx6ulx/conf/distro/myir-imx-fb.conf
```bitbake
# i.MX DISTRO for the FrameBuffer graphical backend.

include conf/distro/include/myir-imx-base.inc
include conf/distro/include/myir-imx-preferred-env.inc

DISTRO = "myir-imx-fb"


# Remove conflicting backends.
DISTRO_FEATURES_remove = "x11 wayland directfb "


#
#DISTRO_FEATURES_append = " systemd"
#VIRTUAL-RUNTIME_init_manager = "systemd"
#VIRTUAL-RUNTIME_dev_manager = "systemd"
#
##Prevent the SysVinit distribution feature from being automatically enabled
#DISTRO_FEATURES_BACKFILL_CONSIDERED = "sysvinit"
#
##Remove any redundant SysVinit scripts
#VIRTUAL-RUNTIME_initscripts = ""
#
##Licenses for firmware etc.
#LICENSE_FLAGS_WHITELIST = "commercial license"
#
##Systemd - enable networkd
#PACKAGECONFIG_append_pn-systemd = " networkd"
#
#
## Remove conflicting backends.
#DISTRO_FEATURES_remove = "x11 wayland directfb "
```
